/*
This code is used for the DRS on the HASP project to take a data stream from serial (Rx/Tx) and log it to an SD card on a SPI line
Author: Lorenzo Narducci
Project: HASP
*/

#include <SPI.h>
#include <SD.h>

File file;
int incomingByte = 0;
unsigned long elapsed_seconds = 0;

void setup() {
  // Let's setup this jawn
  // TODO: double check baud rate
  Serial.begin(9600);
  // TODO: Remove before flight, this is for debugging purposes only
  while (!Serial) {
    ; // wait for serial port to connect. Needed for native USB port only
  }
  // SD card writing taken from here -> https://www.arduino.cc/en/Tutorial/ReadWrite
  Serial.print("Initializing SD card...");

  // CS pin -> may need to update
  if (!SD.begin(4)) {
    Serial.println("initialization failed!");
    while (1);
  }
  Serial.println("initialization done.");

  // open the file. note that only one file can be open at a time,
  // so you have to close this one before opening another.
  // TODO: versioning??
  file = SD.open("data.txt", FILE_WRITE);
  if (!file){
    Serial.println("Error opening file to write");
  }
  
}



void loop() {
  
  String write_string = "";
  
  // TODO: add indicator LED
  
  // if we have stuff on the serial line
  if (Serial.available() > 0) {
    
    // read string from serial line
    // TODO: set write string size
    while (write_string.length() < 10) {
      incomingByte = Serial.read();
    
      // for debugging:
      Serial.print("Recieved: ");
      Serial.println(incomingByte, DEC);
     
      write_string.concat(incomingByte);
      
    }
    
    // get time elapsed since program began
    elapsed_seconds = millis()/1000.0;
    
    // log to SD
    file.print(elapsed_seconds);
    file.print(", ");
    file.println(write_string);
    
    // Flush the file so we don't lose data
    file.flush();
  }

}
